## main/Kconfig.projbuild
```kconfig
menu "Blink Configuration"
config BLINK_GPIO
        int "Blink GPIO number"
        range 0 48
        default 38
        help
            GPIO number (IOxx) to blink on and off the LED.
            Some GPIOs are used for other purposes (flash connections, etc.) and cannot be used to blink.

    config BLINK_PERIOD
        int "Blink period in ms"
        range 10 3600000
        default 1000
        help
            Define the blinking period in milliseconds.

endmenu
```
